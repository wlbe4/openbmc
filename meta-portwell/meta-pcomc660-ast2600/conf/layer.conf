## meta-portwell/meta-pcomc660-ast2600/conf/layer.conf
```bitbake
# We have a conf and classes directory, add to BBPATH
BBPATH .= ":${LAYERDIR}"

# We have recipes-* directories, add to BBFILES
BBFILES += "${LAYERDIR}/recipes-*/*/*.bb \
            ${LAYERDIR}/recipes-*/*/*.bbappend \
            ${LAYERDIR}/../recipes-*/*/*.bb \
            ${LAYERDIR}/../recipes-*/*/*.bbappend"

BBFILE_COLLECTIONS += "pcomc660-ast2600"
BBFILE_PATTERN_pcomc660-ast2600 = "^${LAYERDIR}/"

LAYERSERIES_COMPAT_pcomc660-ast2600 = "langdale mickledore"
```

## meta-portwell/meta-pcomc660-ast2600/conf/machine/pcomc660-ast2600.conf
```bitbake
KMACHINE = "aspeed"

#KERNEL_DEVICETREE = "aspeed-ast2600-evb.dtb"
KERNEL_DEVICETREE = "pcomc660-ast2600.dtb"
UBOOT_MACHINE = "ast2600_openbmc_defconfig"
UBOOT_DEVICETREE = "ast2600a1-evb"

require conf/machine/include/ast2600.inc

SERIAL_CONSOLES = "115200;ttyS4"

require conf/machine/include/ast2600.inc
require conf/machine/include/obmc-bsp-common.inc

MACHINE_FEATURES += "\
        obmc-phosphor-fan-mgmt \
        obmc-phosphor-chassis-mgmt \
        obmc-phosphor-flash-mgmt \
        obmc-host-ipmi \
        obmc-host-ctl \
        obmc-host-state-mgmt \
        obmc-chassis-state-mgmt \
        obmc-bmc-state-mgmt \
        "
FLASH_SIZE = "65536"
#FLASH_SIZE = "32768"
FLASH_KERNEL_OFFSET = "1024"
FLASH_UBOOT_OFFSET = "0"
FLASH_ROFS_OFFSET = "6144"
FLASH_RWFS_OFFSET = "29696"

VIRTUAL-RUNTIME_skeleton_workbook = "${MACHINE}-config"

VIRTUAL-RUNTIME_obmc-host-state-manager ?= "x86-power-control"
VIRTUAL-RUNTIME_obmc-chassis-state-manager ?= "x86-power-control"

PREFERRED_PROVIDER_virtual/obmc-chassis-mgmt = "packagegroup-pw-apps"
PREFERRED_PROVIDER_virtual/obmc-fan-mgmt = "packagegroup-pw-apps"
PREFERRED_PROVIDER_virtual/obmc-flash-mgmt = "packagegroup-pw-apps"
PREFERRED_PROVIDER_virtual/obmc-system-mgmt = "packagegroup-pw-apps"
PREFERRED_PROVIDER_virtual/obmc-inventory-data ?= "${VIRTUAL-RUNTIME_skeleton_workbook}"
PREFERRED_PROVIDER_virtual/obmc-host-ipmi-hw = "phosphor-ipmi-kcs"

PREFERRED_PROVIDER_virtual/phosphor-led-manager-config-native = "pcomc660-ast2600-led-manager-config-native"
```
